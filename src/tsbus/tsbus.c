/*
 * tsbus: the TS-Pico v3 card's bus, as a MicroPython module (phase 3 of the v3
 * port plan, docs/v3-firmware-port-plan.md in the tspico-hardware repo).
 *
 * The card has no memory chips: it answers every 2068 memory read it owns
 * from images in SRAM, and the TS-Pico ports 0Eh/0Fh from core 1. This is the
 * phase 1 bus test (firmware/bringup/bus_card.c in tspico-hardware), moved
 * under MicroPython:
 *
 * - PIO0: serve (reads the address off MD, decides through a chunk table,
 *   asserts /BE, pushes a pointer, drives the byte) and io_drive (replies to
 *   IN 0Eh/0Fh). PIO1: addr_read (the address-buffer enables), mem_write
 *   (every memory write) and io_snoop (every I/O write). Both are full.
 * - DMA: ch_ptr takes serve's pointer and triggers ch_data, which copies the
 *   byte into serve's TX FIFO and chains to ch_log, which logs the pointer.
 * - Core 1 runs only this code, from SRAM, with its own vector table: the bank
 *   shadow (ports F4h, FFh) and the chunk table, DOCK writes, the IN handler
 *   on /IORD, and OUTs to 0Eh/0Fh.
 * - Images at TSBUS_IMAGE_REGION (the top 256 KB of SRAM, outside the GC heap;
 *   src/boards/TSPICO_V3/memmap): the byte for (address, slot) is at
 *   IMAGE_REGION + 4 * address + slot. Slots: 0 HOME, 1 EXROM, 2 DOCK.
 *
 * Python API:
 *   tsbus.start()                  250 MHz; claim PIO0, PIO1 and 3 DMA channels;
 *                                  start core 1
 *   tsbus.load(slot, data)         copy data into a slot, repeated to fill 64 KB
 *   tsbus.switch(home=, exrom=, dock=)  replace images: a ROM change resets the
 *                                  2068, a DOCK change alone is live
 *   tsbus.reset()                  hold the 2068 for 200 ms, then release it
 *   tsbus.serve(on)                /BE and U3 live (the 2068 must be held)
 *   tsbus.exrom(on), tsbus.dock(on) serve the EXROM / DOCK banks' chunks
 *   tsbus.dock_writes(on)          store the Z80's dock writes (RAM dock) or ignore them
 *   tsbus.read(slot, buf[, off])   copy len(buf) of a slot's image, from off, into buf
 *   tsbus.load_at(slot, off, data) copy data into a slot at off, not repeated
 *   tsbus.hold(on)                 hold the 2068 in reset, or release it
 *   tsbus.stats()                  counters, as a dict
 *   tsbus.MQ()                     v2's MQ over core 1's queues: put, get, tx_fifo,
 *                                  rx_fifo, put_block, status, exec, active
 *   tsbus.modem(on)                answer the TS2050's 8251 at 73h/77h, bridged to
 *                                  the ESP32-C3 on UART0 (usart8251.c, modem2050.c);
 *                                  sets up the UART and two DMA channels
 *   tsbus.modem_mode(m)            0 Hayes (pass-through, DSR 1), 1 2050 (the default)
 *   tsbus.modem_line(on)           Zimodem is up (core 0 powered it and waited) or not
 *   tsbus.modem_poll()             what core 0's idle loop needs, as bits (no allocation)
 *   tsbus.modem_pace(baud)         received characters no faster than baud (0: none)
 *   tsbus.esp_relay(first, idle)   USB <-> the ESP32-C3's UART, byte for byte, to flash
 *                                  Zimodem with the ESP32 ROM's loader (the modem off)
 *
 * Nothing on core 1 may touch flash: LittleFS writes stop execute-in-place,
 * and core 1 is never paused for them (it is not a multicore lockout victim).
 * Its code is __not_in_flash_func and uses registers directly rather than SDK
 * inline helpers, which a size-optimised build may leave out of line in flash.
 * Nor may its IN path touch anything behind the APB bridge (IO_BANK0, PADS...):
 * the bridge stalls for up to 4 us while core 0 erases or programs flash, and
 * an IN gives core 1 about 600 ns (issue #254). So the IN interrupt comes from
 * PIO2 (iord_watch) and U1/U3 are driven through PIO1's spare state machine.
 */

#include <stdlib.h>
#include <string.h>

#include "py/runtime.h"
#include "py/mphal.h"
#include "py/stream.h"

#include "pico/multicore.h"
#include "hardware/clocks.h"
#include "hardware/dma.h"
#include "hardware/gpio.h"
#include "hardware/irq.h"
#include "hardware/pio.h"
#include "hardware/uart.h"
#include "hardware/structs/busctrl.h"
#include "hardware/structs/io_bank0.h"
#include "hardware/structs/m33.h"
#include "hardware/structs/scb.h"
#include "hardware/structs/sio.h"
#include "hardware/vreg.h"

#include "rp2_flash.h"

#include "tspico_v3_pins.h"
#include "usart8251.h"
#include "modem2050.h"
// Generated by pioasm. MicroPython's QSTR scan preprocesses this file (with
// NO_QSTR defined) before the header exists; it needs no PIO names.
#ifndef NO_QSTR
#include "tsbus.pio.h"
#endif

#define TSBUS_IMAGE_REGION 0x20040000u
#define IMAGE_PREFIX (TSBUS_IMAGE_REGION >> 18)
#define IMAGE_SIZE (256 * 1024)
#define SLOT_HOME  0
#define SLOT_EXROM 1
#define SLOT_DOCK  2
#define BUS_CLOCK_HZ 250000000u

extern uint8_t __GcHeapEnd;

static const PIO pio_serve = pio0, pio_addr = pio1, pio_iord = pio2;
static uint sm_serve, sm_iodrv, sm_addr, sm_write, sm_snoop, off_addr;
// The IN path stays off APB (issue #254): sm_en, PIO1's spare state machine,
// never runs; core 1 drives U1 and U3 by writing `set pins` into its INSTR
// register. sm_iord (PIO2) turns /IORD's falling edge into PIO2 IRQ 0.
static uint sm_en, sm_iord;
static int ch_ptr, ch_data, ch_log;
static bool started;

// Set by core 0, read by core 1's loop: volatile, or the compiler reads them
// once at the top of the loop.
static volatile bool serving;     // /BE and U3 requests live
static volatile bool exrom_on;    // EXROM-bank chunks served (with /BE)
static volatile bool dock_on;     // DOCK-bank chunks served (no /BE)
static volatile bool dock_rw = true; // Z80 writes to the dock stored (a RAM dock); false: read-only, v2's flash
static volatile bool held_2068 = true;
static volatile bool core1_ready;

// Timing, in PIO cycles (4 ns at 250 MHz), as phase 1 settled them: serve's
// wait after U2 comes on and before sampling A7..A0, addr_read's U2 and U1
// hold loops (tsbus.pio).
static const uint d_hi = 3, d_lo = 3, hold_hi = 5, hold_lo = 9;

// ---- logs and counters ---------------------------------------------------------

#define LOG_N 4096
static uint32_t addr_log[LOG_N] __attribute__((aligned(LOG_N * 4)));
static uint32_t ring_seen;

static volatile uint8_t sh_hsr, sh_ff;
static volatile uint32_t io_writes, mem_writes, dock_writes, table_updates;
static volatile uint32_t served[3];

// ---- ports 0Eh / 0Fh -------------------------------------------------------------

// Reply queue for IN 0Eh (empty reads 00h), and the status byte IN 0Fh returns.
// Any OUT to 0Eh/0Fh makes the status 00h (busy), as v2.1's PIO did, and goes
// to the receive queue (port 0Fh as 0x100 | data). Python reaches them through
// the MQ object (tsbus.MQ()).
#define TXQ_N 1024
static volatile uint8_t txq[TXQ_N];
static volatile uint32_t txq_head, txq_tail;     // head: core 0; tail: core 1
#define RXQ_N 1024
static volatile uint16_t rxq[RXQ_N];
static volatile uint32_t rxq_head, rxq_tail;     // head: core 1; tail: core 0
static volatile uint32_t rxq_lost;
static volatile uint8_t io_status = 0xff;
// Core 0 asks core 1 to drop the oldest reply (MQ's "pull (noblock)"): only
// core 1 advances txq_tail, because its IN handler pops it.
static volatile bool tx_drop_req;

static volatile uint32_t io_ins, io_in_ours, io_outs_ours, io_in_late, respond_max;

// ---- the TS2050 modem: an 8251 at 73h / 77h -----------------------------------------

// docs/v3-modem-proposal.md. Core 1 answers the two ports from `usart`
// (usart8251.c) while modem_on; `modem` (modem2050.c) moves bytes between
// the 8251's rings (u_rx, u_tx) and the line's (line_rx, line_tx), and in
// 2050 mode dials, reads Zimodem's results and drives DSR. The line is the
// ESP32-C3's UART0 (GPIO 44 TX, 45 RX, 115200 8N1, Zimodem), moved by DMA
// so neither core touches the UART's registers on the bus path: ch_mrx
// copies every received byte into line_rx, endlessly (a ring the size of
// the buffer); core 1 starts ch_mtx on a run of line_tx whenever it has
// bytes and the channel is idle. Both are AHB registers, safe for core 1;
// the UART is behind APB (#254).
#define MODEM_UART uart0
#define PIN_MODEM_TX 44
#define PIN_MODEM_RX 45
#define MODEM_BAUD 115200
#define LINE_RX_N 4096
#define LINE_RX_BITS 12
#define LINE_TX_N 1024
#define U_RX_N 1024
#define U_TX_N 1024
static uint8_t line_rx[LINE_RX_N] __attribute__((aligned(LINE_RX_N)));
static uint8_t line_tx[LINE_TX_N];
static uint8_t u_rx[U_RX_N], u_tx[U_TX_N];
static u8251_t usart;
static m2050_t modem;
static uint8_t modem_mode = M2050_2050;   // what tsbus.modem(True) sets up
static volatile bool modem_on;
static bool pace_set;               // tsbus.modem_pace has been called
static int ch_mrx = -1, ch_mtx = -1;
static uint32_t mrx_off;            // where ch_mrx had got to in line_rx, last pass
static uint32_t mtx_inflight;       // bytes ch_mtx is sending
static volatile uint32_t modem_ins; // INs from 73h/77h answered
// Powering the ESP32 is core 0's (the expander is I2C, behind APB): core 1
// only says what it saw. modem_wake: an OUT to the 8251 (a program started
// using it); modem_touched: any IN or OUT (it still is). Both are cleared by
// tsbus.modem_poll(). modem_line_up: Zimodem is running; until then nothing
// goes to the UART (it waits in line_tx) and what comes in is dropped (the
// boot banner, or noise from an ESP that is off).
static volatile bool modem_wake, modem_touched, modem_line_up;

// The 2068 stopped: /MEMRD hasn't changed for IDLE_CYC. A running Z80 reads
// memory every few T-states (a HALT too), so that is a reset (/MEMRD high) or
// the 2068 switched off with the card on USB (/MEMRD low). The card can't see
// /RESET or the 2068's power, so this is how it knows. See core1_main.
#define IDLE_CYC (BUS_CLOCK_HZ / 10000)  // 100 us
static volatile bool bus_idle;
static volatile uint32_t idle_resets;    // times the bus went idle (and was released)
static volatile uint32_t glitch_writes;  // F4h/FFh writes io_snoop saw while idle: ignored

// The 2068's power. Off, every bus line reads 0 V -- /MEMWR, /IORD and /IOWR
// all low together, which a running Z80 never does (one strobe at a time).
// With the card on USB it doesn't restart when the 2068 is switched on, and
// the 2068 then came up frozen mid-read (white border, black screen) until
// TS Reset was pressed; held through its power-up and released 100 ms later
// it boots. So core 1 holds /RESET while the 2068 is off and for
// POWER_ON_CYC after it comes on (power_held), as v2's 555 does for a card
// that isn't on USB. held_2068 is core 0's own hold; the pin is either.
#define POWER_OFF_CYC (BUS_CLOCK_HZ / 1000)   // 1 ms of all-low: off
#define POWER_ON_CYC  (BUS_CLOCK_HZ / 10)     // 100 ms on before the release
#define OFF_MASK ((1u << PIN_NMEMWR) | (1u << PIN_NIORD) | (1u << PIN_NIOWR))
static volatile bool power_held;
static volatile uint32_t power_resets;   // power-ups the card held the 2068 through

// TSBUS_DIAG (issue #254): IN timing per test phase, for the flash-write
// status glitch. The table and tsbus.diag*() are always built (MicroPython's
// QSTR scan doesn't see the flag); only the measuring in the IN handler and
// core 1's loop needs TSBUS_DIAG=1 in the environment at build time
// (src/tsbus/micropython.cmake). Without it every count stays 0.
#ifndef TSBUS_DIAG
#define TSBUS_DIAG 0
#endif
#define DIAG_PHASES 16
#define DIAG_BUCKETS 8
typedef struct {
    uint32_t ins;        // INs to 0Eh/0Fh
    uint32_t gone;       // /IORD already high when the handler started
    uint32_t missed;     // /IORD high by the time U3 went on: the Z80 read an undriven bus
    uint32_t min_left;   // fewest cycles from handler entry to the strobe's end
    uint32_t max_gap;    // longest core 1 loop pass, in cycles (an IN handler included)
    uint32_t hist[DIAG_BUCKETS];   // cycles from entry to the strobe's end, 64 a bucket
    uint32_t drive_max;  // most cycles from the reply's TX write to MD showing it
    uint32_t drive_never;   // MD never showed the reply within DIAG_DRIVE_MAX
    uint32_t dhist[DIAG_BUCKETS];  // that time, 8 cycles (32 ns) a bucket
    uint32_t pio_rd_max; // core 1's slowest read of a PIO0 register (AHB), cycles
    uint32_t apb_rd_max; // ... of an IO_BANK0 register (through the APB bridge)
    uint32_t ram_rd_max; // ... of SRAM
} diag_t;
#define DIAG_DRIVE_MAX 250        // 1 us
#ifndef DIAG_APB_PROBE
#define DIAG_APB_PROBE 0          // 1: also time an IO_BANK0 read (it perturbs the IN path)
#endif
static diag_t diag[DIAG_PHASES];          // all zero in a normal build
static volatile uint32_t diag_probe[256];  // core 1's SRAM latency probe
static volatile uint32_t diag_phase;

// ---- serve's table and patches -----------------------------------------------------

// serve is loaded at offset 0, so its labels are instruction addresses, and a
// table entry is an unconditional jmp: the encoding is just the target.
static uint __not_in_flash_func(chunk_target)(uint chunk, uint hsr, uint ff) {
    if ((hsr >> chunk) & 1) {
        if (ff & 0x80) {
            return exrom_on ? serve_offset_path_e : serve_offset_tail;
        }
        return dock_on ? serve_offset_path_d : serve_offset_tail;
    }
    return chunk < 2 ? serve_offset_path_h : serve_offset_tail;
}

static void __not_in_flash_func(write_table)(void) {
    uint hsr = sh_hsr, ff = sh_ff;
    for (uint c = 0; c < 8; c++) {
        pio_serve->instr_mem[c] = chunk_target(c, hsr, ff);
    }
    table_updates++;
}

// serve has one optional side-set pin, so its instruction word is opt (bit 12),
// side value (bit 11), delay (bits 10:8). Shadow mode drops the /BE side-sets on
// path_e and path_h and turns the U3 request into a nop with the same delay.
#define SIDE_BITS  0x1800u
#define DELAY_BITS 0x0700u
static void set_serving(bool on) {
    serving = on;
    uint16_t e = serve_program_instructions[serve_offset_path_e];
    uint16_t h = serve_program_instructions[serve_offset_path_h];
    pio_serve->instr_mem[serve_offset_path_e] = on ? e : (e & ~SIDE_BITS);
    pio_serve->instr_mem[serve_offset_path_h] = on ? h : (h & ~SIDE_BITS);
    uint16_t req = on ? serve_program_instructions[serve_offset_req] : pio_encode_nop();
    pio_serve->instr_mem[serve_offset_req] = (req & ~DELAY_BITS) | (d_lo << 8);
}

static void set_delays(void) {
    pio_serve->instr_mem[serve_offset_entry] =
        (serve_program_instructions[serve_offset_entry] & ~DELAY_BITS) | (d_hi << 8);
    pio_addr->instr_mem[off_addr + addr_read_offset_hi_hold] = pio_encode_set(pio_y, hold_hi);
    // lo_hold also side-sets U1 on (opt bit and value in bits 12:9 for 3 pins + opt).
    pio_addr->instr_mem[off_addr + addr_read_offset_lo_hold] =
        (addr_read_program_instructions[addr_read_offset_lo_hold] & ~0x1fu) | hold_lo;
}

// ---- start: PIO and DMA ------------------------------------------------------------

static int claim_sm(PIO pio) {
    int sm = pio_claim_unused_sm(pio, false);
    if (sm < 0) {
        mp_raise_msg_varg(&mp_type_OSError, MP_ERROR_TEXT("tsbus: no free state machine in PIO%d"),
            pio_get_index(pio));
    }
    return sm;
}

static uint add_program(PIO pio, const pio_program_t *prog) {
    if (!pio_can_add_program(pio, prog)) {
        mp_raise_msg_varg(&mp_type_OSError, MP_ERROR_TEXT("tsbus: no room in PIO%d"), pio_get_index(pio));
    }
    return pio_add_program(pio, prog);
}

static int claim_dma(void) {
    int ch = dma_claim_unused_channel(false);
    if (ch < 0) {
        mp_raise_msg(&mp_type_OSError, MP_ERROR_TEXT("tsbus: no free DMA channel"));
    }
    return ch;
}

static void bus_start(void) {
    pio_set_gpio_base(pio_serve, 0);
    pio_set_gpio_base(pio_addr, 0);

    // serve (PIO0, offset 0): MD and BE_REQ. MD starts as inputs, /BE off.
    sm_serve = claim_sm(pio_serve);
    if (!pio_can_add_program_at_offset(pio_serve, &serve_program, 0)) {
        mp_raise_msg(&mp_type_OSError, MP_ERROR_TEXT("tsbus: PIO0 offset 0 is in use"));
    }
    pio_add_program_at_offset(pio_serve, &serve_program, 0);
    pio_sm_config c = serve_program_get_default_config(0);
    sm_config_set_in_pin_base(&c, PIN_MD0);
    sm_config_set_out_pins(&c, PIN_MD0, 8);
    sm_config_set_sideset_pin_base(&c, PIN_BE_REQ);
    sm_config_set_in_shift(&c, false, true, 18);
    sm_config_set_out_shift(&c, true, false, 32);
    pio_sm_set_pins_with_mask(pio_serve, sm_serve, 0, (1u << PIN_BE_REQ));
    pio_sm_set_pindirs_with_mask(pio_serve, sm_serve, 1u << PIN_BE_REQ, (1u << PIN_BE_REQ) | 0xffu);
    for (uint p = PIN_MD0; p < PIN_MD0 + 8; p++) {
        pio_gpio_init(pio_serve, p);
    }
    pio_gpio_init(pio_serve, PIN_BE_REQ);
    pio_sm_init(pio_serve, sm_serve, serve_offset_entry, &c);
    pio_sm_put(pio_serve, sm_serve, IMAGE_PREFIX);
    pio_sm_exec(pio_serve, sm_serve, pio_encode_pull(false, true));
    pio_sm_exec(pio_serve, sm_serve, pio_encode_mov(pio_x, pio_osr));
    write_table();
    set_serving(false);

    // io_drive (PIO0): drives replies to IN 0Eh/0Fh onto MD.
    sm_iodrv = claim_sm(pio_serve);
    uint off_iodrv = add_program(pio_serve, &io_drive_program);
    c = io_drive_program_get_default_config(off_iodrv);
    sm_config_set_out_pins(&c, PIN_MD0, 8);
    sm_config_set_out_shift(&c, true, false, 32);
    pio_sm_init(pio_serve, sm_iodrv, off_iodrv, &c);

    // addr_read, mem_write, io_snoop (PIO1): the three buffer enables, all off.
    const uint32_t en = (1u << PIN_NAEN_LO) | (1u << PIN_NAEN_HI) | (1u << PIN_NDATA_OE);
    sm_addr = claim_sm(pio_addr);
    off_addr = add_program(pio_addr, &addr_read_program);
    c = addr_read_program_get_default_config(off_addr);
    sm_config_set_sideset_pin_base(&c, PIN_NAEN_LO);
    sm_config_set_jmp_pin(&c, PIN_NMEMRD);
    sm_config_set_mov_status(&c, STATUS_IRQ_SET, 2);
    pio_sm_set_pins_with_mask(pio_addr, sm_addr, en, en);
    pio_sm_set_pindirs_with_mask(pio_addr, sm_addr, en, en);
    pio_gpio_init(pio_addr, PIN_NAEN_LO);
    pio_gpio_init(pio_addr, PIN_NAEN_HI);
    pio_gpio_init(pio_addr, PIN_NDATA_OE);
    pio_sm_init(pio_addr, sm_addr, off_addr, &c);

    sm_write = claim_sm(pio_addr);
    uint off_write = add_program(pio_addr, &mem_write_program);
    c = mem_write_program_get_default_config(off_write);
    sm_config_set_in_pin_base(&c, PIN_MD0);
    sm_config_set_sideset_pin_base(&c, PIN_NAEN_LO);
    sm_config_set_in_shift(&c, false, true, 24);
    sm_config_set_fifo_join(&c, PIO_FIFO_JOIN_RX);
    pio_sm_init(pio_addr, sm_write, off_write, &c);

    sm_snoop = claim_sm(pio_addr);
    uint off_snoop = add_program(pio_addr, &io_snoop_program);
    c = io_snoop_program_get_default_config(off_snoop);
    sm_config_set_in_pin_base(&c, PIN_MD0);
    sm_config_set_sideset_pin_base(&c, PIN_NAEN_LO);
    sm_config_set_in_shift(&c, false, true, 16);
    pio_sm_init(pio_addr, sm_snoop, off_snoop, &c);

    // sm_en (PIO1): never enabled; core 1 executes `set pins` on it, over
    // GP8-GP10 (nAEN_LO, nAEN_HI, nDATA_OE), to drive U1 and U3 for an IN.
    sm_en = claim_sm(pio_addr);
    c = pio_get_default_sm_config();
    sm_config_set_set_pins(&c, PIN_NAEN_LO, 3);
    pio_sm_init(pio_addr, sm_en, 0, &c);

    // iord_watch (PIO2): /IORD's falling edge -> PIO2 IRQ 0, for core 1.
    pio_set_gpio_base(pio_iord, 0);
    sm_iord = claim_sm(pio_iord);
    uint off_iord = add_program(pio_iord, &iord_watch_program);
    c = iord_watch_program_get_default_config(off_iord);
    pio_sm_init(pio_iord, sm_iord, off_iord, &c);
    pio_iord->input_sync_bypass = 1u << PIN_NIORD;
    pio_iord->irq = 1u;                                    // nothing pending
    pio_iord->inte0 = PIO_INTR_SM0_BITS;                   // IRQ flag 0 -> PIO2_IRQ_0

    set_delays();
    // Synchronisers bypassed on MD and the read strobe in PIO0; those plus
    // nIOWR in PIO1.
    pio_serve->input_sync_bypass = 0xffu | (1u << PIN_NMEMRD);
    pio_addr->input_sync_bypass = 0xffu | (1u << PIN_NMEMRD) | (1u << PIN_NIOWR);

    // DMA: pointer from serve's RX FIFO -> ch_data's read-address trigger;
    // ch_data copies the byte into serve's TX FIFO, then chains to ch_log,
    // which copies the pointer into the log.
    ch_ptr = claim_dma();
    ch_data = claim_dma();
    ch_log = claim_dma();
    memset(addr_log, 0xff, sizeof addr_log);

    dma_channel_config l = dma_channel_get_default_config(ch_log);
    channel_config_set_transfer_data_size(&l, DMA_SIZE_32);
    channel_config_set_read_increment(&l, false);
    channel_config_set_write_increment(&l, true);
    channel_config_set_ring(&l, true, 14);
    dma_channel_configure(ch_log, &l, addr_log, &dma_hw->ch[ch_data].read_addr, 1, false);

    dma_channel_config d = dma_channel_get_default_config(ch_data);
    channel_config_set_transfer_data_size(&d, DMA_SIZE_8);
    channel_config_set_read_increment(&d, false);
    channel_config_set_write_increment(&d, false);
    channel_config_set_high_priority(&d, true);
    channel_config_set_chain_to(&d, ch_log);
    dma_channel_configure(ch_data, &d, &pio_serve->txf[sm_serve], NULL, 1, false);

    dma_channel_config p = dma_channel_get_default_config(ch_ptr);
    channel_config_set_transfer_data_size(&p, DMA_SIZE_32);
    channel_config_set_read_increment(&p, false);
    channel_config_set_write_increment(&p, false);
    channel_config_set_dreq(&p, pio_get_dreq(pio_serve, sm_serve, false));
    channel_config_set_high_priority(&p, true);
    dma_channel_configure(ch_ptr, &p, &dma_hw->ch[ch_data].al3_read_addr_trig, &pio_serve->rxf[sm_serve],
        dma_encode_endless_transfer_count(), true);

    pio_sm_set_enabled(pio_serve, sm_serve, true);
    pio_sm_set_enabled(pio_serve, sm_iodrv, true);
    pio_sm_set_enabled(pio_addr, sm_addr, true);
    pio_sm_set_enabled(pio_addr, sm_write, true);
    pio_sm_set_enabled(pio_addr, sm_snoop, true);
    pio_sm_set_enabled(pio_iord, sm_iord, true);
}

// ---- core 1 --------------------------------------------------------------------------

// `set pins` for sm_en, over GP8 nAEN_LO, GP9 nAEN_HI, GP10 nDATA_OE (active
// low): U1 on, U3 on, all off -- what PIO1's programs leave between cycles.
#define EN_U1  (pio_encode_set(pio_pins, 0b110))
#define EN_U3  (pio_encode_set(pio_pins, 0b011))
#define EN_OFF (pio_encode_set(pio_pins, 0b111))
#define IORD_MASK (1u << PIN_NIORD)

// How long U3 may stay on waiting for the strobe to end, in core cycles from
// the handler's entry. The SCLD stops the Z80's clock while it updates the
// screen, which stretches some IN cycles to 2.4 us (tspico-hardware
// firmware/bringup/README.md, "Long IN strobes"); the guard only keeps U3 from
// staying on if /IORD sticks low.
#define IO_TIMEOUT_CYC 1000   // 4 us at 250 MHz

// An IN is in progress (nIORD low). Read the port through U1; for 0Eh/0Fh put
// the reply on MD (io_drive) and U3 on until the strobe ends. About 600 ns
// before the Z80 samples the data.
static void __not_in_flash_func(handle_in)(void) {
    uint32_t t0c = m33_hw->dwt_cyccnt;
    io_ins++;
    #if TSBUS_DIAG
    bool low_at_entry = !(sio_hw->gpio_in & IORD_MASK);
    bool ours = false, low_at_drive = false;
    #endif
    pio_addr->sm[sm_en].instr = EN_U1;                             // U1: A7..A0 onto MD
    (void)pio_addr->fstat;                                         // the store has landed
    busy_wait_at_least_cycles(8);                                  // ~32 ns: U1 enable plus margin
    uint port = sio_hw->gpio_in & 0xff;
    pio_addr->sm[sm_en].instr = EN_OFF;
    bool answer = true;
    uint8_t reply = 0x00;
    if ((port & 0xfe) == 0x0e) {
        if (port & 1) {
            reply = io_status;
        } else if ((int32_t)(txq_head - txq_tail) > 0) {
            reply = txq[txq_tail % TXQ_N];
            txq_tail++;
        }
    } else if (modem_on && (port & 0xfb) == 0x73) {   // the 8251: 73h data, 77h status
        reply = (port & 4) ? u8251_status(&usart) : u8251_data_in(&usart);
        modem_ins++;
        modem_touched = true;
    } else {
        answer = false;
    }
    if (answer) {
        #if TSBUS_DIAG
        uint32_t tw = m33_hw->dwt_cyccnt;
        #endif
        pio_serve->txf[sm_iodrv] = reply;                              // io_drive: onto MD
        busy_wait_at_least_cycles(4);
        pio_addr->sm[sm_en].instr = EN_U3;                         // U3: MD onto the Z80's bus
        (void)pio_addr->fstat;
        #if TSBUS_DIAG
        low_at_drive = !(sio_hw->gpio_in & IORD_MASK);
        ours = true;
        {
            // How long until MD shows the reply (U3 is already on: this only
            // measures, it changes nothing the Z80 sees).
            diag_t *g = &diag[diag_phase & (DIAG_PHASES - 1)];
            while ((sio_hw->gpio_in & 0xff) != reply && m33_hw->dwt_cyccnt - tw < DIAG_DRIVE_MAX) {
            }
            uint32_t dd = m33_hw->dwt_cyccnt - tw;
            if ((sio_hw->gpio_in & 0xff) != reply) {
                g->drive_never++;
            }
            if (dd > g->drive_max) {
                g->drive_max = dd;
            }
            uint b = dd / 8;
            g->dhist[b < DIAG_BUCKETS ? b : DIAG_BUCKETS - 1]++;
        }
        #endif
        io_in_ours++;
        uint32_t dt = m33_hw->dwt_cyccnt - t0c;
        if (dt > respond_max) {
            respond_max = dt;
        }
    }
    // Wait for the strobe to end, with a guard so U3 can never stay on.
    while (!(sio_hw->gpio_in & IORD_MASK)) {
        if (m33_hw->dwt_cyccnt - t0c > IO_TIMEOUT_CYC) {
            io_in_late++;
            break;
        }
    }
    pio_addr->sm[sm_en].instr = EN_OFF;
    #if TSBUS_DIAG
    if (ours) {
        diag_t *g = &diag[diag_phase & (DIAG_PHASES - 1)];
        uint32_t left = m33_hw->dwt_cyccnt - t0c;
        g->ins++;
        if (!low_at_entry) {
            g->gone++;
        } else if (!low_at_drive) {
            g->missed++;
        }
        if (left < g->min_left) {
            g->min_left = left;
        }
        uint b = left / 64;
        g->hist[b < DIAG_BUCKETS ? b : DIAG_BUCKETS - 1]++;
    }
    #endif
}

// A falling edge on nIORD interrupts core 1 wherever its loop is (polling left
// gaps of up to 370 ns, too many for an IN's 600 ns), through iord_watch on
// PIO2: a GPIO edge interrupt would be acknowledged through APB (issue #254).
// Edges only, so a line held low in reset is never taken for INs; and never
// while the 2068 is held.
static void __not_in_flash_func(iord_isr)(void) {
    pio_iord->irq = 1u;                     // acknowledge PIO2 IRQ flag 0 (AHB, not APB)
    if (!held_2068 && !power_held) {
        handle_in();
    }
}

// Core 1's own vector table. Both cores start with core 0's, whose handlers
// MicroPython keeps in flash; core 1 needs iord_isr on PIO2_IRQ_0. 16 system vectors plus the IRQs, aligned to the next
// power of two above the table's size.
#define CORE1_NVEC (16 + NUM_IRQS)
static uint32_t core1_vectors[CORE1_NVEC] __attribute__((aligned(512)));
static uint32_t core1_stack[1024];   // 4 KB

static void __not_in_flash_func(core1_main)(void) {
    // Setup may call flash code: core 0 waits in tsbus.start() until it is done.
    const uint32_t *v = (const uint32_t *)scb_hw->vtor;
    for (uint i = 0; i < CORE1_NVEC; i++) {
        core1_vectors[i] = v[i];
    }
    core1_vectors[16 + PIO2_IRQ_0] = (uint32_t)iord_isr;
    scb_hw->vtor = (uintptr_t)core1_vectors;
    __dsb();
    __isb();

    m33_hw->demcr |= M33_DEMCR_TRCENA_BITS;
    m33_hw->dwt_ctrl |= M33_DWT_CTRL_CYCCNTENA_BITS;
    pio_iord->irq = 1u;
    irq_set_priority(PIO2_IRQ_0, 0);
    irq_set_enabled(PIO2_IRQ_0, true);                            // for this core
    core1_ready = true;

    const uint32_t snoop_empty = 1u << (PIO_FSTAT_RXEMPTY_LSB + sm_snoop);
    const uint32_t write_empty = 1u << (PIO_FSTAT_RXEMPTY_LSB + sm_write);
    #if TSBUS_DIAG
    uint32_t diag_last = m33_hw->dwt_cyccnt;
    #endif
    // serve's `mov pindirs, null side 0`, the instruction after `tail`'s wait:
    // MD released, /BE off.
    const uint16_t serve_release = serve_program_instructions[serve_offset_tail + 1];
    bool memrd_last = sio_hw->gpio_in & (1u << PIN_NMEMRD);
    uint32_t memrd_change = m33_hw->dwt_cyccnt;
    uint32_t power_off_at = m33_hw->dwt_cyccnt, power_on_at = power_off_at;
    for (;;) {
        #if TSBUS_DIAG
        {
            uint32_t now = m33_hw->dwt_cyccnt;
            uint32_t gap = now - diag_last;
            diag_t *g = &diag[diag_phase & (DIAG_PHASES - 1)];
            if (gap > g->max_gap) {
                g->max_gap = gap;
            }
            // Bus latency from core 1, one read of each path a pass. Not
            // APB: a read that stalls behind the bridge holds core 1 off the
            // IN interrupt and queues its stores (the cause of #254). The APB
            // figure is only measured when DIAG_APB_PROBE is set.
            uint32_t a = m33_hw->dwt_cyccnt;
            (void)pio_serve->fstat;
            uint32_t b = m33_hw->dwt_cyccnt;
            #if DIAG_APB_PROBE
            (void)io_bank0_hw->io[PIN_NIORD].ctrl;
            #endif
            uint32_t c = m33_hw->dwt_cyccnt;
            (void)diag_probe[(c >> 4) & 255];
            uint32_t d = m33_hw->dwt_cyccnt;
            if (b - a > g->pio_rd_max) {
                g->pio_rd_max = b - a;
            }
            if (c - b > g->apb_rd_max) {
                g->apb_rd_max = c - b;
            }
            if (d - c > g->ram_rd_max) {
                g->ram_rd_max = d - c;
            }
            diag_last = m33_hw->dwt_cyccnt;
        }
        #endif
        // A drop request from core 0, with the IN interrupt masked so the
        // handler can't pop in the middle.
        if (tx_drop_req) {
            __asm volatile ("cpsid i" ::: "memory");
            if ((int32_t)(txq_head - txq_tail) > 0) {
                txq_tail++;
            }
            __asm volatile ("cpsie i" ::: "memory");
            tx_drop_req = false;
        }
        // A stopped 2068 (in reset, or off with the card on USB): let go of the
        // bus. With the 2068 off /MEMRD reads low, which serve and addr_read
        // take for a read that never ends, holding /BE and U3 on into an
        // unpowered machine. The shadow stays: the SCLD keeps its bank
        // registers through a reset (see hold_2068); only a power-up clears
        // them, which the power hold below follows. I/O "writes" while idle
        // are power-down noise: no Z80 is running to make them.
        {
            uint32_t now = m33_hw->dwt_cyccnt;
            bool rd = sio_hw->gpio_in & (1u << PIN_NMEMRD);
            if (rd != memrd_last) {
                memrd_last = rd;
                memrd_change = now;
                bus_idle = false;
            } else if (!bus_idle && now - memrd_change > IDLE_CYC) {
                bus_idle = true;
                idle_resets++;
                pio_addr->sm[sm_en].instr = EN_OFF;            // U1, U2, U3 off
                pio_serve->sm[sm_serve].instr = serve_release; // MD in, /BE off
            }
        }
        // The 2068's power: hold /RESET while it is off, and for POWER_ON_CYC
        // after it comes on; then the shadow is clear (it powers up that way)
        // and core 0's hold, if any, is all that's left.
        {
            uint32_t now = m33_hw->dwt_cyccnt;
            bool off = !(sio_hw->gpio_in & OFF_MASK);
            if (off) {
                power_on_at = now;
                if (!power_held && now - power_off_at > POWER_OFF_CYC) {
                    power_held = true;
                    sio_hw->gpio_set = 1u << PIN_RESET_HOLD;
                }
            } else {
                power_off_at = now;
                if (power_held && now - power_on_at > POWER_ON_CYC) {
                    sh_hsr = sh_ff = 0;
                    write_table();
                    power_held = false;
                    power_resets++;
                    if (!held_2068) {
                        sio_hw->gpio_clr = 1u << PIN_RESET_HOLD;
                    }
                }
            }
        }
        // The modem's line: what ch_mrx has received, what ch_mtx has sent,
        // the next run to send, and the 8251's pacing and status.
        if (modem_on) {
            uint32_t off = (dma_hw->ch[ch_mrx].write_addr - (uint32_t)line_rx) & (LINE_RX_N - 1);
            uint32_t got = (off - mrx_off) & (LINE_RX_N - 1);
            mrx_off = off;
            bool idle = !(dma_hw->ch[ch_mtx].ctrl_trig & DMA_CH0_CTRL_TRIG_BUSY_BITS);
            modem.lrx_head += got;
            if (!modem_line_up) {
                modem.lrx_tail = modem.lrx_head;      // nobody there yet: drop it
            }
            if (idle) {
                modem.ltx_tail += mtx_inflight;
                mtx_inflight = 0;
            }
            uint32_t now = m33_hw->dwt_cyccnt;
            m2050_poll(&modem, &usart, now);           // unmasked, as above
            u8251_poll(&usart, now);
            if (idle && modem_line_up && modem.ltx_head != modem.ltx_tail) {
                uint32_t at = modem.ltx_tail & (LINE_TX_N - 1);
                uint32_t n = modem.ltx_head - modem.ltx_tail;
                if (n > LINE_TX_N - at) {
                    n = LINE_TX_N - at;            // to the ring's end; the rest next time
                }
                mtx_inflight = n;
                dma_hw->ch[ch_mtx].read_addr = (uint32_t)&line_tx[at];
                dma_hw->ch[ch_mtx].al1_transfer_count_trig = n;
            }
        }
        // I/O writes: the bank shadow, OUTs to 0Eh/0Fh, and the 8251's.
        if (!(pio_addr->fstat & snoop_empty)) {
            uint32_t w = pio_addr->rxf[sm_snoop];
            uint port = (w >> 8) & 0xff, data = w & 0xff;
            io_writes++;
            if (bus_idle && (port == 0xf4 || port == 0xff)) {
                glitch_writes++;              // no Z80 is running: power-down noise
                continue;
            }
            bool changed = false;
            if (port == 0xf4) {
                changed = sh_hsr != data;
                sh_hsr = (uint8_t)data;
            }
            if (port == 0xff) {
                changed = (sh_ff ^ data) & 0x80;
                sh_ff = (uint8_t)data;
            }
            if (changed) {
                write_table();
            }
            if (modem_on && (port & 0xfb) == 0x73) {
                modem_wake = modem_touched = true;
                // Not masked: the IN handler must never wait (usart8251.h).
                if (port & 4) {
                    u8251_control(&usart, (uint8_t)data);
                } else {
                    u8251_data_out(&usart, (uint8_t)data);
                }
            }
            if ((port & 0xfe) == 0x0e) {
                io_status = 0x00;             // busy until the firmware answers
                io_outs_ours++;
                if (rxq_head - rxq_tail < RXQ_N) {
                    rxq[rxq_head % RXQ_N] = (uint16_t)((port & 1) << 8 | data);
                    __dmb();
                    rxq_head++;
                } else {
                    rxq_lost++;
                }
            }
            continue;
        }
        // Memory writes: into the DOCK image when the shadow maps the chunk to
        // the dock. The Z80 may read the byte back about a microsecond later.
        if (!(pio_addr->fstat & write_empty)) {
            uint32_t w = pio_addr->rxf[sm_write];
            uint addr = (w >> 8) & 0xffff;
            mem_writes++;
            if (dock_on && dock_rw && ((sh_hsr >> (addr >> 13)) & 1) && !(sh_ff & 0x80)) {
                ((uint8_t *)TSBUS_IMAGE_REGION)[4 * addr + SLOT_DOCK] = (uint8_t)w;
                dock_writes++;
            }
            continue;
        }
        // Count served reads by slot from the log.
        uint32_t now = (dma_hw->ch[ch_log].write_addr - (uint32_t)addr_log) / 4;
        if (ring_seen != now) {
            uint slot = addr_log[ring_seen] & 3;
            if (slot < 3) {
                served[slot]++;
            }
            ring_seen = (ring_seen + 1) & (LOG_N - 1);
        }
    }
}

// ---- holding the 2068 ------------------------------------------------------------------

static void hold_2068(bool hold) {
    if (!hold && held_2068) {
        // The SCLD powers up with both registers clear; assume that.
        sh_hsr = sh_ff = 0;
        write_table();
    }
    held_2068 = hold;
    gpio_put(PIN_RESET_HOLD, hold || power_held);   // core 1 may be holding a powered-off 2068
    gpio_set_dir(PIN_RESET_HOLD, GPIO_OUT);
}

// ---- the clock ----------------------------------------------------------------------------

// 250 MHz with the core at 1.20 V, as phase 1 ran: the byte has to be on MD
// well inside an opcode fetch. In the order machine.freq() uses: the regulator
// first, then the flash divider (MicroPython's, in RAM; at most 84 MHz, so 3),
// then the clock. clk_peri and USB run from the USB PLL and do not change.
static void bus_clock(void) {
    if (clock_get_hz(clk_sys) == BUS_CLOCK_HZ) {
        return;
    }
    vreg_set_voltage(VREG_VOLTAGE_1_20);
    mp_hal_delay_ms(2);
    rp2_flash_set_timing_for_freq(BUS_CLOCK_HZ);
    if (!set_sys_clock_khz(BUS_CLOCK_HZ / 1000, false)) {
        mp_raise_msg(&mp_type_RuntimeError, MP_ERROR_TEXT("tsbus: cannot set 250 MHz"));
    }
}

// ---- Python ------------------------------------------------------------------------------

static void require_started(void) {
    if (!started) {
        mp_raise_msg(&mp_type_RuntimeError, MP_ERROR_TEXT("tsbus not started"));
    }
}

// tsbus.start(): claim the PIO and DMA, start core 1. The 2068 stays held.
// Does nothing if already running (tsbus survives a soft reset).
static mp_obj_t tsbus_start(void) {
    if (started) {
        return mp_const_none;
    }
    if ((uintptr_t)&__GcHeapEnd > TSBUS_IMAGE_REGION) {
        mp_raise_msg(&mp_type_RuntimeError, MP_ERROR_TEXT("tsbus: the GC heap overlaps the image region"));
    }
    bus_clock();
    memset((void *)TSBUS_IMAGE_REGION, 0xff, IMAGE_SIZE);
    // The DMA chain answers each read: give it the bus over the cores.
    busctrl_hw->priority = BUSCTRL_BUS_PRIORITY_DMA_W_BITS | BUSCTRL_BUS_PRIORITY_DMA_R_BITS;
    hold_2068(true);
    bus_start();
    core1_ready = false;
    multicore_launch_core1_with_stack(core1_main, core1_stack, sizeof core1_stack);
    for (uint32_t t0 = mp_hal_ticks_ms(); !core1_ready;) {
        if (mp_hal_ticks_ms() - t0 > 100) {
            mp_raise_msg(&mp_type_RuntimeError, MP_ERROR_TEXT("tsbus: core 1 did not start"));
        }
    }
    started = true;
    return mp_const_none;
}
static MP_DEFINE_CONST_FUN_OBJ_0(tsbus_start_obj, tsbus_start);

// tsbus.load(slot, data): copy data into slot 0 (HOME), 1 (EXROM) or 2 (DOCK),
// repeated to fill its 64 KB. Takes effect at once, so load what the 2068 is
// running only while it is held.
static void image_buffer(mp_obj_t data_in, mp_buffer_info_t *buf) {
    mp_get_buffer_raise(data_in, buf, MP_BUFFER_READ);
    if (buf->len == 0 || buf->len > 0x10000) {
        mp_raise_ValueError(MP_ERROR_TEXT("data must be 1 to 65536 bytes"));
    }
}

// Copy an image into a slot, repeated to fill its 64 KB. About 1 ms.
static void load_slot(uint slot, const mp_buffer_info_t *buf) {
    const uint8_t *src = buf->buf;
    uint8_t *r = (uint8_t *)TSBUS_IMAGE_REGION;
    for (uint32_t a = 0, i = 0; a < 0x10000; a++) {
        r[4 * a + slot] = src[i];
        if (++i == buf->len) {
            i = 0;
        }
    }
}

// The slot and an offset into it, checked against a length: (slot, offset)
// for read and load_at.
static void slot_range(mp_obj_t slot_in, mp_obj_t off_in, size_t len, mp_int_t *slot, mp_int_t *off) {
    *slot = mp_obj_get_int(slot_in);
    if (*slot < SLOT_HOME || *slot > SLOT_DOCK) {
        mp_raise_ValueError(MP_ERROR_TEXT("slot must be 0, 1 or 2"));
    }
    *off = off_in == MP_OBJ_NULL ? 0 : mp_obj_get_int(off_in);
    if (*off < 0 || len == 0 || (size_t)*off + len > 0x10000) {
        mp_raise_ValueError(MP_ERROR_TEXT("outside the slot's 64 KB"));
    }
}

// tsbus.read(slot, buf[, offset]): the slot's image from offset back out,
// len(buf) bytes: the DOCK with the Z80's writes in it, to save a RAM dock
// before it is switched away. Python reads it in 32 KB halves (the v3 heap
// has no 64 KB to spare once the firmware runs). About 0.5 ms a half; core 1
// may still be writing.
static mp_obj_t tsbus_read(size_t n_args, const mp_obj_t *args) {
    mp_buffer_info_t buf;
    mp_get_buffer_raise(args[1], &buf, MP_BUFFER_WRITE);
    mp_int_t slot, off;
    slot_range(args[0], n_args > 2 ? args[2] : MP_OBJ_NULL, buf.len, &slot, &off);
    uint8_t *dst = buf.buf;
    const uint8_t *r = (const uint8_t *)TSBUS_IMAGE_REGION;
    for (uint32_t i = 0; i < buf.len; i++) {
        dst[i] = r[4 * (off + i) + slot];
    }
    return mp_const_none;
}
static MP_DEFINE_CONST_FUN_OBJ_VAR_BETWEEN(tsbus_read_obj, 2, 3, tsbus_read);

// tsbus.load_at(slot, offset, data): copy data into the slot at offset, once
// (load repeats a short image to fill 64 KB; this doesn't). For the DOCK in
// two 32 KB halves. Takes effect at once, as load: turn the DOCK off for the
// copy (tsbus.dock(False)), as switch does, if the 2068 is running.
static mp_obj_t tsbus_load_at(mp_obj_t slot_in, mp_obj_t off_in, mp_obj_t data_in) {
    mp_buffer_info_t buf;
    mp_get_buffer_raise(data_in, &buf, MP_BUFFER_READ);
    mp_int_t slot, off;
    slot_range(slot_in, off_in, buf.len, &slot, &off);
    const uint8_t *src = buf.buf;
    uint8_t *r = (uint8_t *)TSBUS_IMAGE_REGION;
    for (uint32_t i = 0; i < buf.len; i++) {
        r[4 * (off + i) + slot] = src[i];
    }
    return mp_const_none;
}
static MP_DEFINE_CONST_FUN_OBJ_3(tsbus_load_at_obj, tsbus_load_at);

static mp_obj_t tsbus_load(mp_obj_t slot_in, mp_obj_t data_in) {
    mp_int_t slot = mp_obj_get_int(slot_in);
    if (slot < SLOT_HOME || slot > SLOT_DOCK) {
        mp_raise_ValueError(MP_ERROR_TEXT("slot must be 0, 1 or 2"));
    }
    mp_buffer_info_t buf;
    image_buffer(data_in, &buf);
    load_slot(slot, &buf);
    return mp_const_none;
}
static MP_DEFINE_CONST_FUN_OBJ_2(tsbus_load_obj, tsbus_load);

// tsbus.serve(on): /BE and U3 requests live, or shadow mode (the card follows
// every read without driving the 2068). Only while the 2068 is held.
static mp_obj_t tsbus_serve(mp_obj_t on_in) {
    require_started();
    if (!held_2068) {
        mp_raise_msg(&mp_type_RuntimeError, MP_ERROR_TEXT("hold the 2068 first"));
    }
    set_serving(mp_obj_is_true(on_in));
    return mp_const_none;
}
static MP_DEFINE_CONST_FUN_OBJ_1(tsbus_serve_obj, tsbus_serve);

// tsbus.exrom(on), tsbus.dock(on): serve the chunks the bank registers map to
// the EXROM (with /BE) or the DOCK (no /BE; writes stored).
static mp_obj_t tsbus_exrom(mp_obj_t on_in) {
    require_started();
    exrom_on = mp_obj_is_true(on_in);
    write_table();
    return mp_const_none;
}
static MP_DEFINE_CONST_FUN_OBJ_1(tsbus_exrom_obj, tsbus_exrom);

static mp_obj_t tsbus_dock(mp_obj_t on_in) {
    require_started();
    dock_on = mp_obj_is_true(on_in);
    write_table();
    return mp_const_none;
}
static MP_DEFINE_CONST_FUN_OBJ_1(tsbus_dock_obj, tsbus_dock);

// tsbus.dock_writes(on): store the Z80's writes into the DOCK image (a RAM
// dock, MEM 1), or ignore them (a flash dock, MEM 2: v2's flash chip ignores
// them too). On at start.
static mp_obj_t tsbus_dock_writes(mp_obj_t on_in) {
    dock_rw = mp_obj_is_true(on_in);
    return mp_const_none;
}
static MP_DEFINE_CONST_FUN_OBJ_1(tsbus_dock_writes_obj, tsbus_dock_writes);

// tsbus.hold(on): hold the 2068 in reset (RESET_HOLD high), or release it.
static mp_obj_t tsbus_hold(mp_obj_t on_in) {
    require_started();
    hold_2068(mp_obj_is_true(on_in));
    return mp_const_none;
}
static MP_DEFINE_CONST_FUN_OBJ_1(tsbus_hold_obj, tsbus_hold);

#define RESET_MS 200   // the 2068 held in reset this long, as phase 1's 'r'

// tsbus.reset(): hold the 2068 in reset for RESET_MS, then release it. The
// shadow starts again from the SCLD's power-up state (hold_2068).
static mp_obj_t tsbus_reset(void) {
    require_started();
    hold_2068(true);
    mp_hal_delay_ms(RESET_MS);
    hold_2068(false);
    return mp_const_none;
}
static MP_DEFINE_CONST_FUN_OBJ_0(tsbus_reset_obj, tsbus_reset);

// tsbus.switch(home=None, exrom=None, dock=None): replace the images given.
//
// A HOME or EXROM change resets the 2068 if it is running: held, the images
// loaded, released after RESET_MS, so it starts cleanly in the new ROM. (A ROM
// changed under a running Z80 would run a mix of the two.) If it is held, the
// images are loaded and it stays held.
//
// A DOCK change on its own is live, as v2's tpi:memdock: DOCK serving is
// turned off for the copy, so a DOCK read during it sees an empty dock instead
// of half the new image, then turned back on. The 2068 keeps running.
static mp_obj_t tsbus_switch(size_t n_args, const mp_obj_t *pos_args, mp_map_t *kw_args) {
    enum { ARG_home, ARG_exrom, ARG_dock };
    static const mp_arg_t allowed_args[] = {
        { MP_QSTR_home, MP_ARG_KW_ONLY | MP_ARG_OBJ, {.u_rom_obj = MP_ROM_NONE} },
        { MP_QSTR_exrom, MP_ARG_KW_ONLY | MP_ARG_OBJ, {.u_rom_obj = MP_ROM_NONE} },
        { MP_QSTR_dock, MP_ARG_KW_ONLY | MP_ARG_OBJ, {.u_rom_obj = MP_ROM_NONE} },
    };
    mp_arg_val_t args[MP_ARRAY_SIZE(allowed_args)];
    mp_arg_parse_all(n_args, pos_args, kw_args, MP_ARRAY_SIZE(allowed_args), allowed_args, args);
    require_started();

    // Check every buffer before touching anything.
    mp_buffer_info_t buf[3];
    bool given[3];
    for (uint s = 0; s < 3; s++) {
        given[s] = args[s].u_obj != mp_const_none;
        if (given[s]) {
            image_buffer(args[s].u_obj, &buf[s]);
        }
    }
    bool rom = given[SLOT_HOME] || given[SLOT_EXROM];
    bool running = !held_2068;

    if (rom) {
        uint32_t t0 = mp_hal_ticks_ms();
        if (running) {
            hold_2068(true);
        }
        for (uint s = 0; s < 3; s++) {
            if (given[s]) {
                load_slot(s, &buf[s]);
            }
        }
        if (running) {
            while (mp_hal_ticks_ms() - t0 < RESET_MS) {
                mp_event_handle_nowait();
            }
            hold_2068(false);
        }
    } else if (given[SLOT_DOCK]) {
        bool was = dock_on;
        dock_on = false;
        write_table();
        load_slot(SLOT_DOCK, &buf[SLOT_DOCK]);
        dock_on = was;
        write_table();
    }
    return mp_const_none;
}
static MP_DEFINE_CONST_FUN_OBJ_KW(tsbus_switch_obj, 0, tsbus_switch);

static void store(mp_obj_t d, qstr k, mp_uint_t v) {
    mp_obj_dict_store(d, MP_OBJ_NEW_QSTR(k), mp_obj_new_int_from_uint(v));
}

// tsbus.stats(): the counters, as a dict.
// tsbus.modem(on): answer the 8251 at 73h/77h (on) or leave the ports to
// nobody (off). Every tsbus.modem(True) sets the line up from scratch: core 1
// stops servicing it, ch_mtx is aborted, UART0 is initialised again (a
// MicroPython soft reset calls uart_deinit on it, whoever set it up), ch_mrx
// restarts at the top of line_rx, the 8251 is as at power-up, expecting a
// mode byte, and the modem is on-hook in modem_mode (tsbus.modem_mode). The
// channels are claimed once and kept. Powering the ESP32 is
// board_v3.modem_power's job.
static mp_obj_t tsbus_modem(mp_obj_t on_in) {
    require_started();
    modem_on = false;                       // core 1 leaves usart and the channels alone
    mp_hal_delay_ms(1);                     // ... once it is past its current pass
    if (!mp_obj_is_true(on_in)) {
        if (ch_mrx >= 0) {                  // and the UART is free (tsbus.esp_relay)
            dma_channel_abort(ch_mrx);
            dma_channel_abort(ch_mtx);
        }
        return mp_const_none;
    }
    if (ch_mrx < 0) {
        ch_mrx = claim_dma();
        ch_mtx = claim_dma();
    }
    dma_channel_abort(ch_mrx);
    dma_channel_abort(ch_mtx);
    uart_init(MODEM_UART, MODEM_BAUD);     // 8N1, FIFOs on, DMA requests on
    gpio_set_function(PIN_MODEM_TX, GPIO_FUNC_UART);
    gpio_set_function(PIN_MODEM_RX, GPIO_FUNC_UART);

    dma_channel_config r = dma_channel_get_default_config(ch_mrx);
    channel_config_set_transfer_data_size(&r, DMA_SIZE_8);
    channel_config_set_read_increment(&r, false);
    channel_config_set_write_increment(&r, true);
    channel_config_set_ring(&r, true, LINE_RX_BITS);
    channel_config_set_dreq(&r, uart_get_dreq(MODEM_UART, false));
    dma_channel_configure(ch_mrx, &r, line_rx, &uart_get_hw(MODEM_UART)->dr,
        dma_encode_endless_transfer_count(), true);

    dma_channel_config t = dma_channel_get_default_config(ch_mtx);
    channel_config_set_transfer_data_size(&t, DMA_SIZE_8);
    channel_config_set_read_increment(&t, true);
    channel_config_set_write_increment(&t, false);
    channel_config_set_dreq(&t, uart_get_dreq(MODEM_UART, true));
    dma_channel_configure(ch_mtx, &t, &uart_get_hw(MODEM_UART)->dr, line_tx, 0, false);

    uint32_t pace = usart.pace;
    u8251_init(&usart, u_rx, U_RX_N, u_tx, U_TX_N);
    usart.pace = pace_set ? pace : BUS_CLOCK_HZ / 300 * 10;   // 300 baud until modem_pace says
    m2050_init(&modem, modem_mode, BUS_CLOCK_HZ / 1000, line_rx, LINE_RX_N, line_tx, LINE_TX_N);
    usart.dsr = modem_mode == M2050_HAYES;
    mrx_off = 0;
    mtx_inflight = 0;
    modem_wake = modem_touched = false;
    __dmb();
    modem_on = true;
    return mp_const_none;
}
static MP_DEFINE_CONST_FUN_OBJ_1(tsbus_modem_obj, tsbus_modem);

// tsbus.modem_mode(m): 0 Hayes (every byte both ways, DSR held at 1), 1 2050
// (pulse dialing, Zimodem's results read here, DSR the connection). Kept for
// later tsbus.modem(True) calls; with the modem on, it is set up again in the
// new mode now (on-hook, as at power-up).
static mp_obj_t tsbus_modem_mode(mp_obj_t mode_in) {
    mp_int_t m = mp_obj_get_int(mode_in);
    if (m != M2050_HAYES && m != M2050_2050) {
        mp_raise_ValueError(MP_ERROR_TEXT("mode"));
    }
    modem_mode = (uint8_t)m;
    if (modem_on) {
        tsbus_modem(mp_const_true);
    }
    return mp_const_none;
}
static MP_DEFINE_CONST_FUN_OBJ_1(tsbus_modem_mode_obj, tsbus_modem_mode);

// tsbus.modem_line(on): Zimodem is up (core 0 powered the ESP32 and gave it
// time to boot), or not. Kept across tsbus.modem(True). While it isn't,
// core 1 sends nothing to the UART and drops what arrives.
static mp_obj_t tsbus_modem_line(mp_obj_t on_in) {
    modem_line_up = mp_obj_is_true(on_in);
    return mp_const_none;
}
static MP_DEFINE_CONST_FUN_OBJ_1(tsbus_modem_line_obj, tsbus_modem_line);

// tsbus.modem_poll(): for core 0's idle loop, as a small int (no
// allocation, it runs every idle pass): bit 0 an OUT to the 8251 since the
// last poll, bit 1 off-hook (2050 mode, not on-hook), bit 2 any IN or OUT
// since the last poll. Bits 0 and 2 are cleared by the read.
static mp_obj_t tsbus_modem_poll(void) {
    mp_int_t r = 0;
    if (modem_on) {
        if (modem_wake) {
            r |= 1;
        }
        if (modem_mode == M2050_2050 && modem.state != M2050_ONHOOK) {
            r |= 2;
        }
        if (modem_touched) {
            r |= 4;
        }
        modem_wake = modem_touched = false;
    }
    return MP_OBJ_NEW_SMALL_INT(r);
}
static MP_DEFINE_CONST_FUN_OBJ_0(tsbus_modem_poll_obj, tsbus_modem_poll);

// tsbus.modem_pace(baud): a received character becomes RxRDY no sooner than
// one 10-bit character time at `baud` after the last; 0: as soon as the last
// is read. Kept across tsbus.modem(True).
static mp_obj_t tsbus_modem_pace(mp_obj_t baud_in) {
    mp_int_t baud = mp_obj_get_int(baud_in);
    if (baud < 0) {
        mp_raise_ValueError(MP_ERROR_TEXT("baud"));
    }
    usart.pace = baud ? BUS_CLOCK_HZ / (uint32_t)baud * 10 : 0;
    pace_set = true;
    return mp_const_none;
}
static MP_DEFINE_CONST_FUN_OBJ_1(tsbus_modem_pace_obj, tsbus_modem_pace);

// tsbus.esp_relay(first_ms, idle_ms): the USB serial port and the ESP32-C3's
// UART0 joined byte for byte, so a host can talk to the ESP32 ROM's serial
// loader through the card (to install Zimodem; board_v3.esp_boot(True) has
// put the ESP32 in download mode). 115200 8N1, the loader's own speed: the
// host must not ask it to change (esptool --baud 115200 doesn't). The modem
// must be off (tsbus.modem(False) stops its DMA), and the caller must have
// switched off the REPL's Ctrl-C (micropython.kbd_intr(-1)): a 03h in the
// data would otherwise interrupt. Returns, as (to_esp, from_esp), once the
// host has been quiet for idle_ms after its first byte, or sent nothing for
// first_ms. Runs on core 0; core 1 goes on serving the 2068.
static mp_obj_t tsbus_esp_relay(mp_obj_t first_in, mp_obj_t idle_in) {
    require_started();
    if (modem_on) {
        mp_raise_msg(&mp_type_RuntimeError, MP_ERROR_TEXT("tsbus: modem on"));
    }
    mp_uint_t first_ms = mp_obj_get_int(first_in), idle_ms = mp_obj_get_int(idle_in);
    uart_init(MODEM_UART, MODEM_BAUD);
    uart_set_fifo_enabled(MODEM_UART, true);
    hw_clear_bits(&uart_get_hw(MODEM_UART)->dmacr, UART_UARTDMACR_TXDMAE_BITS | UART_UARTDMACR_RXDMAE_BITS);
    gpio_set_function(PIN_MODEM_TX, GPIO_FUNC_UART);
    gpio_set_function(PIN_MODEM_RX, GPIO_FUNC_UART);
    uint32_t to_esp = 0, from_esp = 0;
    mp_uint_t last = mp_hal_ticks_ms();
    char buf[64];
    for (;;) {
        // The host's bytes, as many as are waiting, into the UART's FIFO.
        while ((mp_hal_stdio_poll(MP_STREAM_POLL_RD) & MP_STREAM_POLL_RD) && uart_is_writable(MODEM_UART)) {
            uart_putc_raw(MODEM_UART, (char)mp_hal_stdin_rx_chr());
            to_esp++;
            last = mp_hal_ticks_ms();
        }
        // The ESP32's, a FIFO's worth at a time, to the host, raw.
        size_t n = 0;
        while (n < sizeof buf && uart_is_readable(MODEM_UART)) {
            buf[n++] = (char)uart_getc(MODEM_UART);
        }
        if (n) {
            mp_hal_stdout_tx_strn(buf, n);
            from_esp += n;
        }
        mp_uint_t quiet = mp_hal_ticks_ms() - last;
        if (quiet > (to_esp ? idle_ms : first_ms)) {
            break;
        }
        mp_event_handle_nowait();           // USB and the soft timers (the LED)
    }
    mp_obj_t r[2] = { mp_obj_new_int_from_uint(to_esp), mp_obj_new_int_from_uint(from_esp) };
    return mp_obj_new_tuple(2, r);
}
static MP_DEFINE_CONST_FUN_OBJ_2(tsbus_esp_relay_obj, tsbus_esp_relay);

static mp_obj_t tsbus_stats(void) {
    mp_obj_t d = mp_obj_new_dict(43);
    store(d, MP_QSTR_home, served[SLOT_HOME]);
    store(d, MP_QSTR_exrom, served[SLOT_EXROM]);
    store(d, MP_QSTR_dock, served[SLOT_DOCK]);
    store(d, MP_QSTR_io_writes, io_writes);
    store(d, MP_QSTR_mem_writes, mem_writes);
    store(d, MP_QSTR_dock_writes, dock_writes);
    store(d, MP_QSTR_table_updates, table_updates);
    store(d, MP_QSTR_ins, io_ins);
    store(d, MP_QSTR_ins_ours, io_in_ours);
    store(d, MP_QSTR_outs_ours, io_outs_ours);
    store(d, MP_QSTR_late, io_in_late);
    store(d, MP_QSTR_idle_resets, idle_resets);
    store(d, MP_QSTR_glitch_writes, glitch_writes);
    store(d, MP_QSTR_idle, bus_idle);
    store(d, MP_QSTR_power_held, power_held);
    store(d, MP_QSTR_power_resets, power_resets);
    store(d, MP_QSTR_respond_ns, (mp_uint_t)((uint64_t)respond_max * 1000000000u / BUS_CLOCK_HZ));
    store(d, MP_QSTR_rx_lost, rxq_lost);
    store(d, MP_QSTR_hsr, sh_hsr);
    store(d, MP_QSTR_ff, sh_ff);
    store(d, MP_QSTR_held, held_2068);
    store(d, MP_QSTR_status, io_status);
    store(d, MP_QSTR_tx, txq_head - txq_tail);
    store(d, MP_QSTR_rx, rxq_head - rxq_tail);
    // The modem (73h/77h).
    store(d, MP_QSTR_m_on, modem_on);
    store(d, MP_QSTR_m_ins, modem_ins);
    store(d, MP_QSTR_m_status, usart.status);
    store(d, MP_QSTR_m_mode, usart.mode);
    store(d, MP_QSTR_m_cmd, usart.cmd);
    store(d, MP_QSTR_m_rx, usart.rx_chars);
    store(d, MP_QSTR_m_tx, usart.tx_chars);
    store(d, MP_QSTR_m_tx_dropped, usart.tx_dropped);
    store(d, MP_QSTR_m_rx_lost, modem.rx_lost);
    store(d, MP_QSTR_m_rxq, (modem.lrx_head - modem.lrx_tail) + (usart.rx_head - usart.rx_tail));
    store(d, MP_QSTR_m_mode_sel, modem_mode);
    store(d, MP_QSTR_m_state, modem.state);
    store(d, MP_QSTR_m_dials, modem.dials);
    store(d, MP_QSTR_m_connects, modem.connects);
    store(d, MP_QSTR_m_carrier_lost, modem.carrier_lost);
    store(d, MP_QSTR_m_line_up, modem_line_up);
    store(d, MP_QSTR_m_pace_us, usart.pace / (BUS_CLOCK_HZ / 1000000));
    return d;
}
static MP_DEFINE_CONST_FUN_OBJ_0(tsbus_stats_obj, tsbus_stats);

// tsbus.diag_reset(): zero every phase. tsbus.diag_phase(n): count what
// follows under phase n (0-15). tsbus.diag(n): phase n as (ins, gone, missed,
// min_left, max_gap, (hist...), drive_max, drive_never, (dhist...),
// pio_rd_max, apb_rd_max, ram_rd_max), cycles at BUS_CLOCK_HZ.
static mp_obj_t tsbus_diag_reset(void) {
    for (uint i = 0; i < DIAG_PHASES; i++) {
        memset((void *)&diag[i], 0, sizeof diag[i]);
        diag[i].min_left = 0xffffffffu;
    }
    return mp_const_none;
}
static MP_DEFINE_CONST_FUN_OBJ_0(tsbus_diag_reset_obj, tsbus_diag_reset);

static mp_obj_t tsbus_diag_phase(mp_obj_t n_in) {
    diag_phase = (uint32_t)mp_obj_get_int(n_in) & (DIAG_PHASES - 1);
    return mp_const_none;
}
static MP_DEFINE_CONST_FUN_OBJ_1(tsbus_diag_phase_obj, tsbus_diag_phase);

static mp_obj_t tsbus_diag(mp_obj_t n_in) {
    diag_t g = diag[mp_obj_get_int(n_in) & (DIAG_PHASES - 1)];
    mp_obj_t h[DIAG_BUCKETS];
    for (uint i = 0; i < DIAG_BUCKETS; i++) {
        h[i] = mp_obj_new_int_from_uint(g.hist[i]);
    }
    mp_obj_t dh[DIAG_BUCKETS];
    for (uint i = 0; i < DIAG_BUCKETS; i++) {
        dh[i] = mp_obj_new_int_from_uint(g.dhist[i]);
    }
    mp_obj_t t[12] = {
        mp_obj_new_int_from_uint(g.ins), mp_obj_new_int_from_uint(g.gone),
        mp_obj_new_int_from_uint(g.missed), mp_obj_new_int_from_uint(g.min_left),
        mp_obj_new_int_from_uint(g.max_gap), mp_obj_new_tuple(DIAG_BUCKETS, h),
        mp_obj_new_int_from_uint(g.drive_max), mp_obj_new_int_from_uint(g.drive_never),
        mp_obj_new_tuple(DIAG_BUCKETS, dh),
        mp_obj_new_int_from_uint(g.pio_rd_max), mp_obj_new_int_from_uint(g.apb_rd_max),
        mp_obj_new_int_from_uint(g.ram_rd_max),
    };
    return mp_obj_new_tuple(12, t);
}
static MP_DEFINE_CONST_FUN_OBJ_1(tsbus_diag_obj, tsbus_diag);

// ---- the MQ object -----------------------------------------------------------------------

// tsbus.MQ(): v2's MQ (an rp2.StateMachine running TS_IO_DUAL) over core 1's
// queues and status byte, so the protocol code can carry over. One object;
// every call returns it. Differences from v2: the queues are 1 KB, not 4
// entries, and tx_fifo()/rx_fifo() report their real levels; put() and get()
// block like StateMachine's but Ctrl-C can interrupt them; exec() understands
// only the instructions MQX uses; active() does nothing (the bus pins are
// dedicated on v3, so there is nothing to stop for SD).

typedef struct {
    mp_obj_base_t base;
} tsbus_mq_obj_t;

static const mp_obj_type_t tsbus_mq_type;
static const tsbus_mq_obj_t tsbus_mq_obj = { { &tsbus_mq_type } };

static mp_obj_t tsbus_mq_make_new(const mp_obj_type_t *type, size_t n_args, size_t n_kw, const mp_obj_t *args) {
    mp_arg_check_num(n_args, n_kw, 0, 0, false);
    require_started();
    return MP_OBJ_FROM_PTR(&tsbus_mq_obj);
}

static inline uint32_t tx_level(void) {
    return txq_head - txq_tail;
}

static inline uint32_t rx_level(void) {
    return rxq_head - rxq_tail;
}

static void tx_push(uint8_t b) {
    while (tx_level() >= TXQ_N) {
        mp_event_handle_nowait();
    }
    txq[txq_head % TXQ_N] = b;
    __dmb();
    txq_head++;
}

// put(value): queue a reply for IN 0Eh; blocks while the queue is full.
static mp_obj_t tsbus_mq_put(mp_obj_t self_in, mp_obj_t value_in) {
    tx_push((uint8_t)mp_obj_get_int(value_in));
    return mp_const_none;
}
static MP_DEFINE_CONST_FUN_OBJ_2(tsbus_mq_put_obj, tsbus_mq_put);

// get(): the next OUT, as a 9-bit word (0x100 | data for port 0Fh); blocks
// while the queue is empty.
static mp_obj_t tsbus_mq_get(mp_obj_t self_in) {
    while (rx_level() == 0) {
        mp_event_handle_nowait();
    }
    uint16_t w = rxq[rxq_tail % RXQ_N];
    __dmb();
    rxq_tail++;
    return MP_OBJ_NEW_SMALL_INT(w);
}
static MP_DEFINE_CONST_FUN_OBJ_1(tsbus_mq_get_obj, tsbus_mq_get);

static mp_obj_t tsbus_mq_tx_fifo(mp_obj_t self_in) {
    return MP_OBJ_NEW_SMALL_INT(tx_level());
}
static MP_DEFINE_CONST_FUN_OBJ_1(tsbus_mq_tx_fifo_obj, tsbus_mq_tx_fifo);

static mp_obj_t tsbus_mq_rx_fifo(mp_obj_t self_in) {
    return MP_OBJ_NEW_SMALL_INT(rx_level());
}
static MP_DEFINE_CONST_FUN_OBJ_1(tsbus_mq_rx_fifo_obj, tsbus_mq_rx_fifo);

// put_block(buf[, wait_ms]): queue a block as the Z80 reads it; returns how
// many bytes were queued. Python never handles the bytes one by one (v2 used
// DMA for this).
//
// Without wait_ms: waits for room until the whole block is queued (Ctrl-C
// still works). With wait_ms >= 0: queues what fits, waits up to wait_ms
// without progress for more room, and returns early when an OUT is waiting
// in RX, so the caller can see a BREAK or an echo (tspico_io.STREAM_QUEUE).
// wait_ms 0 queues what fits now and returns.
static mp_obj_t tsbus_mq_put_block(size_t n_args, const mp_obj_t *args) {
    mp_buffer_info_t buf;
    mp_get_buffer_raise(args[1], &buf, MP_BUFFER_READ);
    const uint8_t *p = buf.buf;
    if (n_args < 3) {
        for (size_t i = 0; i < buf.len; i++) {
            tx_push(p[i]);
        }
        return MP_OBJ_NEW_SMALL_INT(buf.len);
    }
    mp_int_t wait_ms = mp_obj_get_int(args[2]);
    size_t i = 0;
    uint32_t t0 = mp_hal_ticks_ms();
    while (i < buf.len) {
        uint32_t room = TXQ_N - tx_level();
        if (room) {
            size_t k = buf.len - i < room ? buf.len - i : room;
            uint32_t h = txq_head;
            for (size_t j = 0; j < k; j++) {
                txq[(h + j) % TXQ_N] = p[i + j];
            }
            __dmb();
            txq_head = h + k;
            i += k;
            t0 = mp_hal_ticks_ms();
            continue;
        }
        if (rx_level() || (mp_int_t)(mp_hal_ticks_ms() - t0) >= wait_ms) {
            break;
        }
        mp_event_handle_nowait();
    }
    return MP_OBJ_NEW_SMALL_INT(i);
}
static MP_DEFINE_CONST_FUN_OBJ_VAR_BETWEEN(tsbus_mq_put_block_obj, 2, 3, tsbus_mq_put_block);

// status(value): what IN 0Fh returns (v2's Y register). An OUT to 0Eh/0Fh
// sets it to 00h (busy) on its own, as before.
static mp_obj_t tsbus_mq_status(mp_obj_t self_in, mp_obj_t value_in) {
    io_status = (uint8_t)mp_obj_get_int(value_in);
    return mp_const_none;
}
static MP_DEFINE_CONST_FUN_OBJ_2(tsbus_mq_status_obj, tsbus_mq_status);

static void drop_oldest(void) {
    tx_drop_req = true;
    while (tx_drop_req) {
    }
}

// exec(instr): the instructions MQX sends to TS_IO_DUAL on v2, with the same
// effect: Y is the status byte; "pull (noblock)" drops the oldest reply (v2's
// drain loops follow it with "mov (osr, null)", which then has nothing to do).
// Spaces are ignored.
static mp_obj_t tsbus_mq_exec(mp_obj_t self_in, mp_obj_t instr_in) {
    const char *in = mp_obj_str_get_str(instr_in);
    char t[24];
    size_t n = 0;
    for (; *in && n < sizeof t - 1; in++) {
        if (*in != ' ') {
            t[n++] = *in;
        }
    }
    t[n] = 0;
    if (strcmp(t, "mov(y,invert(null))") == 0) {
        io_status = 0xff;
    } else if (strcmp(t, "mov(y,invert(y))") == 0) {
        io_status = (uint8_t)~io_status;
    } else if (strncmp(t, "set(y,", 6) == 0 && t[n - 1] == ')') {
        io_status = (uint8_t)(atoi(t + 6) & 0x1f);
    } else if (strcmp(t, "pull(noblock)") == 0) {
        drop_oldest();
    } else if (strcmp(t, "mov(osr,null)") == 0) {
        // nothing: there is no OSR
    } else {
        mp_raise_ValueError(MP_ERROR_TEXT("tsbus.MQ: unsupported instruction"));
    }
    return mp_const_none;
}
static MP_DEFINE_CONST_FUN_OBJ_2(tsbus_mq_exec_obj, tsbus_mq_exec);

// active([value]): accepted for v2's code; always True.
static mp_obj_t tsbus_mq_active(size_t n_args, const mp_obj_t *args) {
    return mp_const_true;
}
static MP_DEFINE_CONST_FUN_OBJ_VAR_BETWEEN(tsbus_mq_active_obj, 1, 2, tsbus_mq_active);

static const mp_rom_map_elem_t tsbus_mq_locals_table[] = {
    { MP_ROM_QSTR(MP_QSTR_put), MP_ROM_PTR(&tsbus_mq_put_obj) },
    { MP_ROM_QSTR(MP_QSTR_get), MP_ROM_PTR(&tsbus_mq_get_obj) },
    { MP_ROM_QSTR(MP_QSTR_tx_fifo), MP_ROM_PTR(&tsbus_mq_tx_fifo_obj) },
    { MP_ROM_QSTR(MP_QSTR_rx_fifo), MP_ROM_PTR(&tsbus_mq_rx_fifo_obj) },
    { MP_ROM_QSTR(MP_QSTR_put_block), MP_ROM_PTR(&tsbus_mq_put_block_obj) },
    { MP_ROM_QSTR(MP_QSTR_status), MP_ROM_PTR(&tsbus_mq_status_obj) },
    { MP_ROM_QSTR(MP_QSTR_exec), MP_ROM_PTR(&tsbus_mq_exec_obj) },
    { MP_ROM_QSTR(MP_QSTR_active), MP_ROM_PTR(&tsbus_mq_active_obj) },
};
static MP_DEFINE_CONST_DICT(tsbus_mq_locals, tsbus_mq_locals_table);

static MP_DEFINE_CONST_OBJ_TYPE(
    tsbus_mq_type,
    MP_QSTR_MQ,
    MP_TYPE_FLAG_NONE,
    make_new, tsbus_mq_make_new,
    locals_dict, &tsbus_mq_locals
    );

static const mp_rom_map_elem_t tsbus_module_globals_table[] = {
    { MP_ROM_QSTR(MP_QSTR___name__), MP_ROM_QSTR(MP_QSTR_tsbus) },
    { MP_ROM_QSTR(MP_QSTR_start), MP_ROM_PTR(&tsbus_start_obj) },
    { MP_ROM_QSTR(MP_QSTR_load), MP_ROM_PTR(&tsbus_load_obj) },
    { MP_ROM_QSTR(MP_QSTR_switch), MP_ROM_PTR(&tsbus_switch_obj) },
    { MP_ROM_QSTR(MP_QSTR_reset), MP_ROM_PTR(&tsbus_reset_obj) },
    { MP_ROM_QSTR(MP_QSTR_serve), MP_ROM_PTR(&tsbus_serve_obj) },
    { MP_ROM_QSTR(MP_QSTR_exrom), MP_ROM_PTR(&tsbus_exrom_obj) },
    { MP_ROM_QSTR(MP_QSTR_dock), MP_ROM_PTR(&tsbus_dock_obj) },
    { MP_ROM_QSTR(MP_QSTR_dock_writes), MP_ROM_PTR(&tsbus_dock_writes_obj) },
    { MP_ROM_QSTR(MP_QSTR_read), MP_ROM_PTR(&tsbus_read_obj) },
    { MP_ROM_QSTR(MP_QSTR_load_at), MP_ROM_PTR(&tsbus_load_at_obj) },
    { MP_ROM_QSTR(MP_QSTR_hold), MP_ROM_PTR(&tsbus_hold_obj) },
    { MP_ROM_QSTR(MP_QSTR_stats), MP_ROM_PTR(&tsbus_stats_obj) },
    { MP_ROM_QSTR(MP_QSTR_diag), MP_ROM_PTR(&tsbus_diag_obj) },
    { MP_ROM_QSTR(MP_QSTR_diag_phase), MP_ROM_PTR(&tsbus_diag_phase_obj) },
    { MP_ROM_QSTR(MP_QSTR_diag_reset), MP_ROM_PTR(&tsbus_diag_reset_obj) },
    { MP_ROM_QSTR(MP_QSTR_modem), MP_ROM_PTR(&tsbus_modem_obj) },
    { MP_ROM_QSTR(MP_QSTR_modem_mode), MP_ROM_PTR(&tsbus_modem_mode_obj) },
    { MP_ROM_QSTR(MP_QSTR_modem_line), MP_ROM_PTR(&tsbus_modem_line_obj) },
    { MP_ROM_QSTR(MP_QSTR_modem_poll), MP_ROM_PTR(&tsbus_modem_poll_obj) },
    { MP_ROM_QSTR(MP_QSTR_modem_pace), MP_ROM_PTR(&tsbus_modem_pace_obj) },
    { MP_ROM_QSTR(MP_QSTR_esp_relay), MP_ROM_PTR(&tsbus_esp_relay_obj) },
    { MP_ROM_QSTR(MP_QSTR_MQ), MP_ROM_PTR(&tsbus_mq_type) },
    { MP_ROM_QSTR(MP_QSTR_HOME), MP_ROM_INT(SLOT_HOME) },
    { MP_ROM_QSTR(MP_QSTR_EXROM), MP_ROM_INT(SLOT_EXROM) },
    { MP_ROM_QSTR(MP_QSTR_DOCK), MP_ROM_INT(SLOT_DOCK) },
};
static MP_DEFINE_CONST_DICT(tsbus_module_globals, tsbus_module_globals_table);

const mp_obj_module_t tsbus_module = {
    .base = { &mp_type_module },
    .globals = (mp_obj_dict_t *)&tsbus_module_globals,
};

MP_REGISTER_MODULE(MP_QSTR_tsbus, tsbus_module);
